## firmware/main/Kconfig.projbuild
```kconfig
menu "AuscultaForge board profile"
config AF_I2S_CONFIRMED_PROFILE
    bool "Enable physically reviewed INMP441 wiring (hardware qualification still required)"
    default n
    help
        Enable only after checking actual PCB headers, 3.3 V supply, ground,
        and a soldered/verified INMP441 connection. Default firmware remains G1 only.
config AF_I2S_BCLK
    int "Confirmed BCLK GPIO"
    depends on AF_I2S_CONFIRMED_PROFILE
    default 4
config AF_I2S_WS
    int "Confirmed WS GPIO"
    depends on AF_I2S_CONFIRMED_PROFILE
    default 5
config AF_I2S_DIN
    int "Confirmed SD -> DIN GPIO"
    depends on AF_I2S_CONFIRMED_PROFILE
    default 6
config AF_I2S_RIGHT_SLOT
    bool "INMP441 L/R tied to 3.3 V (right slot); otherwise tie to GND (left)"
    depends on AF_I2S_CONFIRMED_PROFILE
    default n
endmenu
```

## firmware/sdkconfig.defaults
```kconfig
CONFIG_IDF_TARGET="esp32s3"
CONFIG_ESPTOOLPY_FLASHSIZE_16MB=y
CONFIG_ESPTOOLPY_FLASHMODE_DIO=y
CONFIG_ESPTOOLPY_FLASHFREQ_80M=y
CONFIG_SPIRAM=y
CONFIG_SPIRAM_MODE_OCT=y
CONFIG_SPIRAM_SPEED_80M=y
CONFIG_SPIRAM_USE_MALLOC=y
CONFIG_PARTITION_TABLE_CUSTOM=y
CONFIG_PARTITION_TABLE_CUSTOM_FILENAME="partitions.csv"
CONFIG_ESP_CONSOLE_UART_DEFAULT=y
CONFIG_ESP_CONSOLE_SECONDARY_NONE=y
CONFIG_FREERTOS_HZ=1000
CONFIG_TINYUSB_CDC_ENABLED=y
CONFIG_TINYUSB_CDC_COUNT=1
CONFIG_TINYUSB_CDC_RX_BUFSIZE=4096
CONFIG_TINYUSB_CDC_TX_BUFSIZE=4096
CONFIG_TINYUSB_CDC_EP_BUFSIZE=4096
CONFIG_TINYUSB_SUSPEND_CALLBACK=y
CONFIG_TINYUSB_RESUME_CALLBACK=y
CONFIG_TINYUSB_DESC_PRODUCT_STRING="AuscultaForge G1"
CONFIG_TINYUSB_DESC_CDC_STRING="Canonical Profile B"
# CONFIG_SECURE_BOOT is not set
# CONFIG_SECURE_FLASH_ENC_ENABLED is not set
```
